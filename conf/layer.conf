## conf/layer.conf
```bitbake
# We have a conf directory, append to BBPATH
BBPATH .= ":${LAYERDIR}"

# We have a recipes directory, add to BBFILES
BBFILES += "${LAYERDIR}/recipes-*/*/*.bb ${LAYERDIR}/recipes-*/*/*.bbappend"

BBFILE_COLLECTIONS += "meta-gumstix"
BBFILE_PATTERN_meta-gumstix := "^${LAYERDIR}/"
BBFILE_PRIORITY_meta-gumstix = "7"
```

## conf/machine/duovero.conf
```bitbake
#@TYPE: Machine
#@NAME: DuoVero
#@DESCRIPTION: Machine configuration for the Gumstix DuoVero

SOC_FAMILY = "omap4"
TARGET_ARCH = "arm"
# We target cortexa8hf-neon rather than cortexa9hf-neon as the only difference
# is -mtune=cortexa9 and this allows us to be consistent with our Cortex-A8
# builds for Pepper and Overo.
DEFAULTTUNE ?= "cortexa8hf-neon"

require conf/machine/include/soc-family.inc
require conf/machine/include/tune-cortexa8.inc

# Specify kernel recipe
PREFERRED_PROVIDER_virtual/kernel ?= "linux-gumstix"

# Specify u-boot parameters
PREFERRED_PROVIDER_virtual/bootloader = "u-boot"
PREFERRED_PROVIDER_u-boot = "u-boot"

UBOOT_ENTRYPOINT = "0x80008000"
UBOOT_LOADADDRESS = "0x80008000"
UBOOT_MACHINE = "duovero_config"
SPL_BINARY = "MLO"
UBOOT_SUFFIX = "img"

EXTRA_IMAGEDEPENDS += "u-boot"

# Specify files for the boot partition for wic
# Note: if UBOOT_ENV is set, it should also be included here
IMAGE_BOOT_FILES ?= "u-boot.${UBOOT_SUFFIX} ${SPL_BINARY}"

# Specify xserver components for builds including X11
PREFERRED_PROVIDER_virtual/xserver = "xserver-xorg"
XSERVER = "xserver-xorg \
           xserver-xorg-module-exa \
           xf86-input-evdev \
           xf86-input-keyboard \
           xf86-input-mouse \
           xf86-video-fbdev \
           xf86-video-omapfb \
           xf86-video-omap"

SERIAL_CONSOLES = "115200;ttyO2"

# tar.b2 for SD card
IMAGE_FSTYPES ?= "tar.bz2"

# Include wifi firmware
MACHINE_EXTRA_RDEPENDS += "linux-firmware-sd8787 linux-firmware-wl18xx"

# Ship all kernel modules by default
MACHINE_EXTRA_RRECOMMENDS = " kernel-modules"
MACHINE_FEATURES = "alsa bluetooth ext2 keyboard serial touchscreen usbgadget usbhost vfat wifi"
```

## conf/machine/imx6dqscm-1gb-gumstix.conf
```bitbake
#@TYPE: Machine
#@NAME: Gumstix i.MX6QSCM Development Board
#@SOC: i.MX6Q
#@DESCRIPTION: Machine configuration for Gumstix i.MX6SCM Development board
#@MAINTAINER: Sicong Jia <sicong.jia@gumstix.com>


SOC_FAMILY = "mx6:mx6q"
require conf/machine/include/soc-family.inc
KERNEL_DEVICETREE = "imx6dqscm-1gb-gumstix.dtb"

require conf/machine/include/imx-base.inc
require conf/machine/include/tune-cortexa9.inc

SERIAL_CONSOLE = "115200 ttymxc0"

MACHINE_FIRMWARE_append_mx6 = " linux-firmware-ath6k"

MACHINE_FEATURES += " pci wifi bluetooth"

IMAGE_FSTYPES = "wic.gz tar.xz"
# wic support
WIC_CREATE_EXTRA_ARGS_append = " --no-fstab-update"

UBOOT_CONFIG ??= "sd"
UBOOT_CONFIG[sd] = "mx6dqscm_1gb_gumstix_defconfig,sdcard"
UBOOT_CONFIG[mfgtool] = "mx6dqscm_1gb_gumstix_defconfig"

MACHINE_FIRMWARE_append = " linux-firmware-wl12xx wl18xx-fw"
MACHINE_EXTRA_RDEPENDS += " wl18xx-fw"
```

## conf/machine/imx6dqscm-2gb-zircon.conf
```bitbake
#@TYPE: Machine
#@NAME: Gumstix Zircon
#@SOC: i.MX6Q
#@DESCRIPTION: Machine configuration for Gumstix Zircon
#@MAINTAINER: Sicong Jia <sicong.jia@gumstix.com>

require conf/machine/include/imx6sabresd-common.inc

SOC_FAMILY = "mx6:mx6q"
require conf/machine/include/soc-family.inc
KERNEL_DEVICETREE = "imx6dqscm-2gb-zircon.dtb"

UBOOT_CONFIG ??= "sd"
UBOOT_CONFIG[sd] = "mx6dqscm_2gb_zircon_defconfig,sdcard"
UBOOT_CONFIG[mfgtool] = "mx6dqscm_2gb_zircon_defconfig"

MACHINE_FIRMWARE_append = " linux-firmware-wl12xx wl18xx-fw"
MACHINE_EXTRA_RDEPENDS += " wl18xx-fw"
```

## conf/machine/include/omap3.inc
```bitbake
SOC_FAMILY = "omap3"
TARGET_ARCH = "arm"

require conf/machine/include/tune-cortexa8.inc

# Increase this everytime you change something in the kernel
MACHINE_KERNEL_PR = "r1"

KERNEL_IMAGETYPE = "uImage"

UBOOT_ENTRYPOINT = "0x80008000"
UBOOT_LOADADDRESS = "0x80008000"
```

## conf/machine/overo-storm.conf
```bitbake
#@TYPE: Machine
#@NAME: overo machine
#@DESCRIPTION: Machine configuration for the Gumstix Overo DM3730 based

require conf/machine/overo.inc
```

## conf/machine/overo.conf
```bitbake
#@TYPE: Machine
#@NAME: Overo machine
#@DESCRIPTION: Machine configuration for the Gumstix Overo 

SOC_FAMILY = "omap3"
TARGET_ARCH = "arm"
# DEFAULTTUNE makes it possible to build for the ARM hardfloat ABI.
DEFAULTTUNE ?= "cortexa8hf-neon"

require conf/machine/include/soc-family.inc
require conf/machine/include/tune-cortexa8.inc

# Specify kernel recipe
PREFERRED_PROVIDER_virtual/kernel ?= "linux-gumstix"

# Specify u-boot parameters
PREFERRED_PROVIDER_virtual/bootloader = "u-boot"
PREFERRED_PROVIDER_u-boot = "u-boot"

UBOOT_ENTRYPOINT = "0x80008000"
UBOOT_LOADADDRESS = "0x80008000"
UBOOT_MACHINE = "omap3_overo_config"
SPL_BINARY = "MLO"
UBOOT_SUFFIX = "img"

EXTRA_IMAGEDEPENDS += "u-boot"

# Specify files for the boot partition for wic
# Note: if UBOOT_ENV is set, it should also be included here
IMAGE_BOOT_FILES ?= "u-boot.${UBOOT_SUFFIX} ${SPL_BINARY}"

# Specify xserver components for builds including X11
PREFERRED_PROVIDER_virtual/xserver = "xserver-xorg"
XSERVER ?= "xserver-xorg \
            xf86-input-evdev \
            xf86-input-keyboard \
            xf86-input-mouse \
            xf86-video-omapfb"

# Default to external video, uncomment for LCD panels
# GUI_MACHINE_CLASS = "smallscreen"
GUI_MACHINE_CLASS ?= "bigscreen"

# For kernels older than 2.6.37, use "115200 ttyS2" instead
SERIAL_CONSOLES = "115200;ttyO2"

# tar.bz2 for SD card, UBI for nand
IMAGE_FSTYPES ?= "tar.bz2 ubi"

# The magic numbers:
# 512 MiB flash = 4096 PEBs (physical erase blocks) (PEB = 128 KiB sector)
# Manufacturer's spec is minimum 4016 PEBs are good for lifetime
# Logical erase block is PEB minus 2 KiB (NAND page size) for metadata
# Partitions reserve 4+14+2+64 PEBS for xloader/u-boot/env/linux
# Minimum remaining available for rootfs: 3932 PEBs (likewise 3932 LEBs)
MKUBIFS_ARGS = "-F -m 2048 -e 126KiB -c 3932"
UBINIZE_ARGS = "-m 2048 -p 128KiB -s 512"

UBI_VOLNAME = "rootfs"

# Include wifi firmware
MACHINE_EXTRA_RDEPENDS += "linux-firmware-sd8686 linux-firmware-sd8787 linux-firmware-wl18xx"

# Ship all kernel modules by default
MACHINE_EXTRA_RRECOMMENDS = " kernel-modules omap3-pwm u-boot-fw-utils"
MACHINE_FEATURES = "alsa bluetooth ext2 keyboard serial touchscreen usbgadget usbhost vfat wifi"

# WIC configs for 2GB SD-Card
WKS_FILE ?= "sdimage-gumstix.wks"
IMAGE_BOOT_FILES = "MLO u-boot.img uImage"
do_image_wic[depends] += "mtools-native:do_populate_sysroot dosfstools-native:do_populate_sysroot"
```

## conf/machine/overo.inc
```bitbake
require conf/machine/include/omap3.inc

EXTRA_IMAGEDEPENDS = "u-boot-sakoman"

PREFERRED_PROVIDER_virtual/bootloader = "u-boot-sakoman"
UBOOT_MACHINE = "omap3_overo_config"
#PREFERRED_VERSION_pn-u-boot = "2011.12"

#PREFERRED_PROVIDER_virtual/kernel = "linux-omap3"
PREFERRED_PROVIDER_ntp = "ntp"
PREFERRED_PROVIDER_virtual/kernel = "linux-sakoman"  

PREFERRED_PROVIDER_virtual/xserver = "xserver-xorg"
XSERVER = "xserver-xorg \
           xf86-input-evdev \
           xf86-input-mouse \
           xf86-video-omapfb \
           xf86-input-keyboard"

PREFERRED_PROVIDER_jpeg = "libjpeg-turbo"
PREFERRED_PROVIDER_jpeg-native = "libjpeg-turbo-native"

SERIAL_CONSOLE = "115200 ttyO2"

IMAGE_FSTYPES += "tar.bz2"

MKUBIFS_ARGS = "-m 2048 -e 129024 -c 4044"
UBINIZE_ARGS = "-m 2048 -p 128KiB -s 512"

UBI_VOLNAME = "rootfs"

MACHINE_EXTRA_RDEPENDS = "omap3-writeprom"
MACHINE_EXTRA_RRECOMMENDS = " kernel-modules"

MACHINE_FEATURES = "kernel26 alsa apm ext3 screen usbgadget usbhost vfat wifi"
```

## conf/machine/pepper.conf
```bitbake
#@TYPE: Machine
#@NAME: Pepper
#@DESCRIPTION: Machine configuration for the Gumstix Pepper

SOC_FAMILY = "ti33x"
TARGET_ARCH = "arm"
# DEFAULTTUNE makes it possible to build for the ARM hardfloat ABI.
DEFAULTTUNE ?= "cortexa8hf-neon"

require conf/machine/include/soc-family.inc
require conf/machine/include/tune-cortexa8.inc

# Specify kernel recipe
PREFERRED_PROVIDER_virtual/kernel ?= "linux-yocto"

# Specify u-boot parameters
PREFERRED_PROVIDER_virtual/bootloader = "u-boot"
PREFERRED_PROVIDER_u-boot = "u-boot"

UBOOT_ENTRYPOINT = "0x80008000"
UBOOT_LOADADDRESS = "0x80008000"
UBOOT_MACHINE = "pepper_config"
SPL_BINARY = "MLO"
UBOOT_SUFFIX = "img"

EXTRA_IMAGEDEPENDS += "u-boot"

# Specify files for the boot partition for wic
# Note: if UBOOT_ENV is set, it should also be included here
IMAGE_BOOT_FILES ?= "u-boot.${UBOOT_SUFFIX} ${SPL_BINARY}"

# Default to LCD.
GUI_MACHINE_CLASS ?= "smallscreen"
PREFERRED_PROVIDER_virtual/xserver = "xserver-xorg"
XSERVER = "xserver-xorg \
           xf86-input-evdev \
           xf86-input-keyboard \
           xf86-input-mouse \
           xf86-video-fbdev"

SERIAL_CONSOLES = "115200;ttyO0"

# tar.bz2 for SD card
IMAGE_FSTYPES ?= "tar.bz2"

# Include wifi firmware
MACHINE_EXTRA_RDEPENDS += "linux-firmware-sd8787 linux-firmware-wl18xx"

# Ship all kernel modules by default
MACHINE_EXTRA_RRECOMMENDS = " kernel-modules"
MACHINE_FEATURES = "alsa bluetooth ext2 keyboard serial touchscreen usbgadget usbhost vfat wifi"
```

## conf/machine/poblano.conf
```bitbake
#@TYPE: Machine
#@NAME: Poblano machine
#@DESCRIPTION: Machine configuration for the Gumstix Poblano.

SOC_FAMILY = "ti43x"
TARGET_ARCH = "arm"
# DEFAULTTUNE makes it possible to build for the ARM hardfloat ABI.
DEFAULTTUNE ?= "cortexa8hf-neon"

require conf/machine/include/soc-family.inc
require conf/machine/include/tune-cortexa8.inc

# Specify kernel recipe
PREFERRED_PROVIDER_virtual/kernel ?= "linux-gumstix"

# Specify u-boot parameters
PREFERRED_PROVIDER_virtual/bootloader = "u-boot"
PREFERRED_PROVIDER_u-boot = "u-boot"

UBOOT_ENTRYPOINT = "0x80008000"
UBOOT_LOADADDRESS = "0x80008000"
UBOOT_MACHINE = "poblano_defconfig"
SPL_BINARY = "MLO"
UBOOT_SUFFIX = "img"

EXTRA_IMAGEDEPENDS += "u-boot"

# Specify files for the boot partition for wic
# Note: if UBOOT_ENV is set, it should also be included here
IMAGE_BOOT_FILES ?= "u-boot.${UBOOT_SUFFIX} ${SPL_BINARY}"

# Specify xserver components for builds including X11
GUI_MACHINE_CLASS ?= "smallscreen"
PREFERRED_PROVIDER_virtual/xserver = "xserver-xorg"
XSERVER ?= "xserver-xorg \
            xf86-input-evdev \
            xf86-input-keyboard \
            xf86-input-mouse \
            xf86-video-fbdev"

SERIAL_CONSOLES = "115200;ttyO0"

# tar.bz2 for SD card
IMAGE_FSTYPES ?= "tar.bz2"

# Include wifi firmware
MACHINE_EXTRA_RDEPENDS += "linux-firmware-wl18xx"

# Ship all kernel modules by default
MACHINE_EXTRA_RRECOMMENDS = " kernel-modules"
MACHINE_FEATURES = "alsa bluetooth ext2 keyboard serial touchscreen usbgadget usbhost vfat wifi"
```
